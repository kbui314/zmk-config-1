## config/boards/shields/manuform/Kconfig.defconfig
```kconfig
if SHIELD_MANUFORM_CENTRAL

config ZMK_KEYBOARD_NAME
	default "Manuform CENTRAL"

config ZMK_SPLIT_BLE_ROLE_CENTRAL
	default y

endif


if SHIELD_MANUFORM_LEFT

config ZMK_KEYBOARD_NAME
	default "Manuform Left"
endif


if SHIELD_MANUFORM_RIGHT

config ZMK_KEYBOARD_NAME
	default "Manuform Right"
	
endif

if SHIELD_MANUFORM_LEFT || SHIELD_MANUFORM_RIGHT || SHIELD_MANUFORM_CENTRAL

config ZMK_SPLIT
	default y

endif
```
