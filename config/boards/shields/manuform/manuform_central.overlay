/*
 * Copyright (c) 2021 The ZMK Contributors
 *
 * SPDX-License-Identifier: MIT
 */

#include "manuform.dtsi"

&kscan0 {
	row-gpios
		= <&gpio0 5 (GPIO_ACTIVE_HIGH | GPIO_PULL_DOWN)>;
	col-gpios
		= <&gpio0 8 GPIO_ACTIVE_HIGH>;
};